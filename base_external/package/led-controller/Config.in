## base_external/package/led-controller/Config.in
```kconfig
config BR2_PACKAGE_LED_CONTROLLER
	bool "led-controller"
	help
	  The LED controller for AESD final project
```

## base_external/package/led-server/Config.in
```kconfig
config BR2_PACKAGE_LED_SERVER
	bool "led-server"
	help
		A socket server to remotely control the led-controller
	depends on BR2_PACKAGE_LED_CONTROLLER
```
